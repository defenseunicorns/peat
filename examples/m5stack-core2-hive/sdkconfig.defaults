## examples/m5stack-core2-hive/sdkconfig.defaults
```kconfig
# HIVE M5Stack Core2 ESP-IDF Configuration

# Rust runtime
CONFIG_ESP_MAIN_TASK_STACK_SIZE=32768

# Bluetooth
CONFIG_BT_ENABLED=y
CONFIG_BT_NIMBLE_ENABLED=y
CONFIG_BT_NIMBLE_MAX_CONNECTIONS=4
CONFIG_BT_NIMBLE_MAX_BONDS=3
CONFIG_BT_NIMBLE_MAX_CCCDS=8
CONFIG_BT_NIMBLE_SVC_GAP_DEVICE_NAME="HIVE-M5Core2"
CONFIG_BT_NIMBLE_GAP_DEVICE_NAME_MAX_LEN=32
CONFIG_BT_NIMBLE_ATT_PREFERRED_MTU=512
CONFIG_BT_NIMBLE_50_FEATURE_SUPPORT=n

# GATT
CONFIG_BT_NIMBLE_NVS_PERSIST=y
CONFIG_BT_NIMBLE_ROLE_CENTRAL=y
CONFIG_BT_NIMBLE_ROLE_PERIPHERAL=y
CONFIG_BT_NIMBLE_ROLE_BROADCASTER=y
CONFIG_BT_NIMBLE_ROLE_OBSERVER=y

# Logging
CONFIG_LOG_DEFAULT_LEVEL_INFO=y
CONFIG_LOG_MAXIMUM_LEVEL_VERBOSE=y

# Power management (for M5Stack Core2)
CONFIG_PM_ENABLE=y
CONFIG_PM_DFS_INIT_AUTO=y

# Flash size (M5Stack Core2 has 16MB)
CONFIG_ESPTOOLPY_FLASHSIZE_16MB=y
# Use single factory partition (4MB max app size)
CONFIG_PARTITION_TABLE_SINGLE_APP_LARGE=y

# PSRAM (M5Stack Core2 has 8MB PSRAM)
CONFIG_ESP32_SPIRAM_SUPPORT=y
CONFIG_SPIRAM_USE_MALLOC=y
CONFIG_SPIRAM_MALLOC_ALWAYSINTERNAL=4096

# Watchdog
CONFIG_ESP_TASK_WDT_TIMEOUT_S=30

# Optimize for size
CONFIG_COMPILER_OPTIMIZATION_SIZE=y
```

## examples/m5stack-core2-peat/sdkconfig.defaults
```kconfig
# Peat M5Stack Core2 ESP-IDF Configuration

# Rust runtime
CONFIG_ESP_MAIN_TASK_STACK_SIZE=32768

# Keep the Rust main task pinned to CPU 0 alongside the NimBLE host
# (CONFIG_BT_NIMBLE_PINNED_TO_CORE_0). NimBLE's internal critical
# sections aren't designed for cross-core contention — pinning main to
# CPU 1 caused our gossip_document calls (on CPU 1) to spin on the
# same hw locks NimBLE was holding on CPU 0, starving IDLE1 and
# tripping the task watchdog. Co-locating them lets FreeRTOS
# timeshare the core via preemption, with no spinlock fight. The
# doc-drain cap (one queued doc per main-loop tick) is what keeps
# main from monopolizing CPU 0 under sync-burst load.
CONFIG_ESP_MAIN_TASK_AFFINITY_CPU0=y

# Bluetooth
CONFIG_BT_ENABLED=y
CONFIG_BT_NIMBLE_ENABLED=y
CONFIG_BT_NIMBLE_MAX_CONNECTIONS=2
CONFIG_BT_NIMBLE_MAX_BONDS=3
CONFIG_BT_NIMBLE_MAX_CCCDS=8
CONFIG_BT_NIMBLE_SVC_GAP_DEVICE_NAME="PEAT-M5Core2"
CONFIG_BT_NIMBLE_GAP_DEVICE_NAME_MAX_LEN=32
CONFIG_BT_NIMBLE_ATT_PREFERRED_MTU=512
CONFIG_BT_NIMBLE_50_FEATURE_SUPPORT=n

# GATT
CONFIG_BT_NIMBLE_NVS_PERSIST=y
CONFIG_BT_NIMBLE_ROLE_CENTRAL=y
CONFIG_BT_NIMBLE_ROLE_PERIPHERAL=y
CONFIG_BT_NIMBLE_ROLE_BROADCASTER=y
CONFIG_BT_NIMBLE_ROLE_OBSERVER=y

# Logging
CONFIG_LOG_DEFAULT_LEVEL_INFO=y
CONFIG_LOG_MAXIMUM_LEVEL_VERBOSE=y

# Power management (for M5Stack Core2)
CONFIG_PM_ENABLE=y
CONFIG_PM_DFS_INIT_AUTO=y

# Flash size (M5Stack Core2 has 16MB)
CONFIG_ESPTOOLPY_FLASHSIZE_16MB=y
# Use default partition table (single factory app)
CONFIG_PARTITION_TABLE_SINGLE_APP=y

# PSRAM (M5Stack Core2 has 8MB PSRAM)
CONFIG_ESP32_SPIRAM_SUPPORT=y
CONFIG_SPIRAM_USE_MALLOC=y
CONFIG_SPIRAM_MALLOC_ALWAYSINTERNAL=4096

# Watchdog. 60 s timeout (up from 30 s) gives headroom for legitimate
# slow paths (NVS flush during a sync burst, NimBLE disconnect cleanup
# chains). IDLE0/IDLE1 stay subscribed — when the device truly locks
# we want a backtrace logged, not silent freeze. Panic stays off so
# WDT triggers don't reboot the device on a transient stall.
CONFIG_ESP_TASK_WDT_TIMEOUT_S=60

# Interrupt watchdog. Default 300 ms was tripping under sustained BLE
# controller load (heavy peer RX combined with our 1 Hz health updates
# and synchronous CCCD writes inside `gatt_disc_dsc_cb`), with the
# backtrace landing inside the VHCI ISR (`vhci_recv_end`). Bumping to
# 1000 ms absorbs that controller-stress window without disabling the
# IWDT — a real ISR hang would still reboot us, just on a more
# realistic threshold for NimBLE on ESP32.
CONFIG_ESP_INT_WDT_TIMEOUT_MS=1000

# Optimize for size
CONFIG_COMPILER_OPTIMIZATION_SIZE=y
```
